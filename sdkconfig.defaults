## sdkconfig.defaults
```kconfig
CONFIG_FREERTOS_HZ=1000
CONFIG_ESP_MAIN_TASK_STACK_SIZE=4096
CONFIG_ESP_INT_WDT_TIMEOUT_MS=2000
CONFIG_ESP_TASK_WDT_TIMEOUT_S=10
CONFIG_COMPILER_OPTIMIZATION_PERF=y

CONFIG_ESP_TLS_USE_DS_PERIPHERAL=n
CONFIG_ESP_TLS_INSECURE=y
CONFIG_ESP_TLS_SKIP_SERVER_CERT_VERIFY=y

CONFIG_ESP_WIFI_STATIC_RX_BUFFER_NUM=6
CONFIG_ESP_WIFI_STATIC_TX_BUFFER_NUM=6
CONFIG_ESP_WIFI_DYNAMIC_RX_MGMT_BUFFER=y
CONFIG_ESP_WIFI_TX_BA_WIN=16
CONFIG_ESP_WIFI_RX_BA_WIN=8
CONFIG_ESP_WIFI_IRAM_OPT=n
CONFIG_ESP_WIFI_RX_IRAM_OPT=n

CONFIG_LWIP_IRAM_OPTIMIZATION=n
CONFIG_LWIP_TCP_RECVMBOX_SIZE=10
CONFIG_LWIP_TCP_ACCEPTMBOX_SIZE=8
CONFIG_LWIP_TCP_OOSEQ_MAX_PBUFS=6
CONFIG_LWIP_FALLBACK_DNS_SERVER_SUPPORT=y
CONFIG_LWIP_DNS_SETSERVER_WITH_NETIF=y
CONFIG_MBEDTLS_EXTERNAL_MEM_ALLOC=y
CONFIG_MBEDTLS_DYNAMIC_BUFFER=y
CONFIG_MBEDTLS_SSL_KEEP_PEER_CERTIFICATE=n

# LVGL
CONFIG_LV_USE_CLIB_MALLOC=y
CONFIG_LV_USE_CLIB_STRING=y
CONFIG_LV_USE_CLIB_SPRINTF=y
CONFIG_LV_DEF_REFR_PERIOD=15
CONFIG_LV_DPI_DEF=60
CONFIG_LV_DRAW_LAYER_SIMPLE_BUF_SIZE=48000
CONFIG_LV_DRAW_SW_SHADOW_CACHE_SIZE=4
CONFIG_LV_GRADIENT_MAX_STOPS=4
CONFIG_LV_OBJ_STYLE_CACHE=y
CONFIG_LV_USE_SYSMON=y
CONFIG_LV_FONT_MONTSERRAT_30=y

# Brookesia:Utils
CONFIG_BROOKESIA_UTILS_THREAD_PROFILER_ENABLE_FREERTOS_CONFIG=y

# Brookesia:Service:SNTP
CONFIG_LWIP_SNTP_MAX_SERVERS=4
CONFIG_LWIP_SNTP_STARTUP_DELAY=n
CONFIG_LWIP_DHCP_GET_NTP_SRV=y
CONFIG_LWIP_DHCP_MAX_NTP_SERVERS=4

# Brookesia:Agent
CONFIG_BROOKESIA_AGENT_MANAGER_DEFAULT_CHAT_MODE_HALF_DUPLEX=y
CONFIG_BROOKESIA_AGENT_MANAGER_HALF_DUPLEX_STOP_ENCODER_WHILE_SPEAKING=y
# Coze
CONFIG_BROOKESIA_AGENT_COZE_ENABLE_AUTO_REGISTER=n
CONFIG_MBEDTLS_DYNAMIC_BUFFER=n
# Openai
CONFIG_WS_BUFFER_SIZE=2048
CONFIG_BROOKESIA_AGENT_OPENAI_ENABLE_AUTO_REGISTER=n
# XiaoZhi
CONFIG_XIAOZHI_AUDIO_TASK_ALLOC_DYNAMIC=y
CONFIG_XIAOZHI_STACK_IN_PSRAM=y
CONFIG_XIAOZHI_SYNC_SYSTEM_TIME_FROM_SERVER=n
CONFIG_BROOKESIA_AGENT_XIAOZHI_ENABLE_AUTO_REGISTER=n
CONFIG_BROOKESIA_AGENT_XIAOZHI_WAKE_WORD="你好小智"

# ESP-SR local wake word model
CONFIG_SR_WN_WN9S_NIHAOXIAOZHI=y

# Brookesia:Expression:Emote
CONFIG_MMAP_FILE_NAME_LENGTH=32

# ESP32-C5 is single-core. The upstream ServiceManager defaults worker 1 to CPU1.
CONFIG_BROOKESIA_SERVICE_MANAGER_WORKER_1_CORE_ID=0

# Keep more internal DRAM for DMA/I2S/Wi-Fi during XiaoZhi TTS (was 8KB, speech peak ran ~1%).
CONFIG_SPIRAM_MALLOC_RESERVE_INTERNAL=16384
```
